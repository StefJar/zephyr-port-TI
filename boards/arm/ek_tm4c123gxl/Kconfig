## dts/bindings/tier,pwm-light-controller.yaml
```yaml
# Copyright (c) 2021 Kamil Sroka, TIER GmbH
# SPDX-License-Identifier: Apache-2.0

description: |
   pwm light controller

compatible: "tier,pwm-light-controller"

include:
    - name: base.yaml

properties:
   label:
      required: true

   timer:
      type: phandle
      required: false
      description: |
         reference to the timer periphal

   subtimer:
     required: false
     type: string
     default: "A"
     enum:
     - "A"
     - "B"
     description: |
       the TI timer has 2 timers A and B so we need to select one

   pinctrl-0:
     type: phandle
     required: false
     description: |
       pin that is used for light control
```

## dts/bindings/tier,shiftreg.yaml
```yaml
# Copyright (c) 2021 Stefan Jaritz, TIER SE
# SPDX-License-Identifier: Apache-2.0

description: |
    shift register like SN74HC595

compatible: "tier,shiftreg"

include:
    - name: base.yaml

properties:
   label:
      required: true
     
   din-gpios:
      type: phandle-array
      required: true
      description: |
         data in    
   
   srclk-gpios:
      type: phandle-array
      required: true    
      description: |
         shift register clock

   latch-gpios:
      type: phandle-array
      required: true    
      description: |
         latch signal
   
   rclk-gpios:
      type: phandle-array
      required: true    
      description: |
         storage register clk (low active)
   
   oe-gpios:
      type: phandle-array
      required: true    
      description: |
         output enable signal (low active)
   
   outputs:
      type: int
      required: true
      description: |
         amount of outputs
      
```
