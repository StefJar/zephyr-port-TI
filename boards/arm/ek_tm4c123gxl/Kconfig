## boards/arm/ek_tm4c123gxl/Kconfig.board
```kconfig
# gorilla pcb board configuration

# Copyright (c) 2021 Stefan Jaritz, TIER GmbH
# SPDX-License-Identifier: Apache-2.0

config BOARD_EK_TM4C123GXL
	bool "ek_tm4c123gxl"
#	depends on SOC_STM32F412ZG
```

## boards/arm/ek_tm4c123gxl/Kconfig.defconfig
```kconfig
# EK_TM4C123GXL board configuration
# Copyright (c) 2016 Nordic Semiconductor ASA
# SPDX-License-Identifier: Apache-2.0

if BOARD_EK_TM4C123GXL

config BOARD
	default "ek_tm4c123gxl"

endif # EK_TM4C123GXL
```

## boards/arm/ek_tm4c123gxl/ek_tm4c123gxl_defconfig
```kconfig
# board and mcu selection
CONFIG_SOC_TI_TM4C12XX=y
CONFIG_BOARD_EK_TM4C123GXL=y

CONFIG_CORTEX_M_SYSTICK=y

# open ocd 
CONFIG_BUILD_OUTPUT_HEX=y

CONFIG_UART_INTERRUPT_DRIVEN=y
# CONFIG_DYNAMIC_INTERRUPTS=y
```

## dts/bindings/adc/ti,tiva-adc.yaml
```yaml
# Copyright (c) 2021 Stefan Jaritz, TIER SE
# SPDX-License-Identifier: Apache-2.0

description: TI Tiva ADC periphal

compatible: "ti,tiva-adc"

include: base.yaml

properties:
   reg:
      required: true

   interrupts:
      required: true

   reference:
      required: true
      type: string
      default: "INT"
      enum:
      - "INT" # Default value.
      - "EXT"
      description: |
         adc Vref
         ... {
             reference = "EXT"; 
         };
         we select VExt+ and VExt- as ADC reference

   oversampling:
      required: true
      type: int
      description: |
         amount of oversampling 0, 2, 4, 8, 16, 32, 64

   pinctrl-0:
      type: phandles
      required: false
      description: |
        GPIO pin configuration for the ADCx channels. The phandles are
        expected to reference pinctrl nodes, e.g.

          pinctrl-0 = <&adc0_ch3>;
```

## dts/bindings/adi,adpd188bi.yaml
```yaml
# Copyright (c) 2021 Stefan Jaritz, TIER SE
# SPDX-License-Identifier: Apache-2.0

description: ADPD188BI I2C integrated optical module for smoke detection

compatible: "adi,adpd188bi"

include: i2c-device.yaml

properties:
    gpio0-gpios:
      type: phandle-array
      required: false
      description: |
        the gpio0 signal pin
```

## dts/bindings/can/ti,tiva-can.yaml
```yaml
# Copyright (c) 2021 Stefan Jaritz, TIER SE
# SPDX-License-Identifier: Apache-2.0

description: TI Tiva CAN controller

compatible: "ti,tiva-can"

include: can-controller.yaml

properties:
    reg:
      required: true

    interrupts:
      required: true

    pinctrl-0:
      type: phandles
      required: false
      description: |
        GPIO pin configuration for CAN RX and TX. The phandles are
        expected to reference pinctrl nodes, e.g.

          pinctrl-0 = <&can1_rx &can1_tx>;

    bus-speed:
      type: int
      required: true
      description: bus speed in Baud/s
```

## dts/bindings/clock/ti,tiva-pll-clock.yaml
```yaml
# Copyright (c) 2021 Stefan Jaritz, TIER SE
# SPDX-License-Identifier: Apache-2.0

description: |
  TI TIVA PLL node binding:

   tiva pll config

compatible: "ti,tiva-pll-clock"

include: [clock-controller.yaml, base.yaml]

properties:
    xtal:
      required: true
      type: int
      description: |
          xtal clk in Hz
      enum:
        - 1000000
        - 1840000
        - 2000000
        - 2450000
        - 3570000
        - 3680000
        - 4000000
        - 4090000
        - 4910000
        - 5000000
        - 5120000
        - 6000000
        - 6140000
        - 7370000
        - 8000000
        - 8190000
        - 10000000
        - 12000000
        - 12200000
        - 13500000
        - 14300000
        - 16000000
        - 16300000
        - 18000000
        - 20000000
        - 24000000
        - 25000000

    sysdiv:
      required: true
      type: int
      description: |
          pll clk divider
      enum:
        - 1
        - 2
        - 3
        - 4
        - 5
        - 6
        - 7
        - 8
        - 9
        - 10
        - 11
        - 12
        - 13
        - 14
        - 15
        - 16
        - 17
        - 18
        - 19
        - 20
        - 21
        - 22
        - 23
        - 24
        - 25
        - 26
        - 27
        - 28
        - 29
        - 30
        - 31
        - 32
        - 33
        - 34
        - 35
        - 36
        - 37
        - 38
        - 39
        - 40
        - 41
        - 42
        - 43
        - 44
        - 45
        - 46
        - 47
        - 48
        - 49
        - 50
        - 51
        - 52
        - 53
        - 54
        - 55
        - 56
        - 57
        - 58
        - 59
        - 60
        - 61
        - 62
        - 63
        - 64
        
    sysdiv_frac:
      required: true
      type: int
      description: |
          pll after comma clk divider 5 = 0.5
      enum:
        - 0
        - 5
```

## dts/bindings/dma/ti,tiva-udma.yaml
```yaml
# Copyright (c) 2021 Stefan Jaritz, TIER SE
# SPDX-License-Identifier: Apache-2.0

description: TI Tiva uDMA periphal

compatible: "ti,tiva-udma"

include: base.yaml

properties:
   reg:
      required: true

   label:
      required: true

   interrupts:
      required: true
      description: |
         list with 2 interrupts. The first for the udma system intr and the other one for the udma error intr

   dma-channels:
      type: int
      required: true
      description: Number of dma channels

   "#dma-cells":
      const: 2
      type: int
      required: true      
      
dma-cells:
   - channel
   - config
```

## dts/bindings/gpio/ti,tiva-gpio.yaml
```yaml
# Copyright (c) 2021 Stefan Jaritz, TIER SE
# SPDX-License-Identifier: Apache-2.0

description: TI TIVA GPIO node

compatible: "ti,tiva-gpio"

include: [gpio-controller.yaml, base.yaml]

properties:
    reg:
      required: true

    label:
      required: true

    interrupts:
      required: true

    "#gpio-cells":
      const: 2

gpio-cells:
  - pin
  - flags
```

## dts/bindings/hc,sr501.yaml
```yaml
# Copyright (c) 2021 Stefan Jaritz, TIER SE
# SPDX-License-Identifier: Apache-2.0

description: HC-SR501 passive infra-red(PIR) motion detector

compatible: "hc,sr501"

include:
    - name: base.yaml

properties:
   label:
      required: true
      
   detectSignal-gpios:
      type: phandle-array
      required: true
      description: |
         the low/high signal that indicates smth has been detected    
```

## dts/bindings/i2c/ti,tiva-i2c.yaml
```yaml
# Copyright (c) 2021 Stefan Jaritz, TIER SE
# SPDX-License-Identifier: Apache-2.0

description: TI TIVA I2C controller

compatible: "ti,tiva-i2c"

include: i2c-controller.yaml

properties:
    reg:
      required: true

    interrupts:
      required: true

    pinctrl-0:
      type: phandles
      required: false
      description: |
        GPIO pin configuration for serial signals (SDA, SCL).  We expect
        that the phandles will reference pinctrl nodes.

        For example the I2C1 would be
           pinctrl-0 = <&i2c1_sda &i2c1_scl>;
```

## dts/bindings/pinctrl/ti,tiva-pinctrl.yaml
```yaml
# Copyright (c) 2021 Stefan Jaritz, TIER SE
# SPDX-License-Identifier: Apache-2.0

description: |
    Tiva Pin controller Node
    Based on pincfg-node.yaml binding.

    Note: `bias-disable` and `drive-push-pull` are default pin configurations.
           They will be applied in case no `bias-foo` or `driver-bar` properties
           are set.

compatible: "ti,tiva-pinctrl"

include:
    - name: base.yaml
    - name: pincfg-node.yaml
      child-binding:
        property-allowlist:
          - bias-disable
          - bias-pull-down
          - bias-pull-up
          - drive-push-pull
          - drive-open-drain

properties:
    reg:
      required: true

child-binding:
    description: |
        This binding gives a base representation of the STM32 pins configration

    properties:
        port:
          required: true
          type: phandle
          description: |
            port refernce
            ... {
                     port = <&gpio_A>;
            };

        pin:
          required: true
          type: int
          description: |
            pin number
            ... {
                     pin-number = <1>;
            };

        map:
          required: true
          type: int
          description: |
            pls look up port and pin at the pin-map.h file with your mcu
            Some examples of macro usage:
            like uart0_rx
            at pin-map.h for tm4c123gh6pm
            "#define GPIO_PA0_U0RX 0x00000001"
            so we go with
            ... {
                     pinmap-def = <0x00000001>;
            };
            
        unlock:
           required: false
           type: boolean
           description: |
              some pins need to be unlocked before they can used like PF0 
              ... {
                  unlock = true;
              };

        dirmode:
           required: true
           type: string
           default: "IN"
           enum:
           - "IN" # Default value.
           - "OUT"
           - "HW"
           description: |
              direction mode
              ... {
                  dirmode = "HW"; 
              };
              we select HW mode for example for CAN

        strength:
           required: false
           type: string
           default: "2MA"
           enum:
           - "2MA" # Default value.
           - "4MA"
           - "8MA"
           - "8MA_SC"
           - "6MA"
           - "10MA"
           - "12MA"
           description: |
              drive strength of the pin
              ... {
                  strength = "4MA"; 
              };
              we select I_max to 4mA

        type:
           required: false
           type: string
           default: "STD"
           enum:
           - "STD" # Default value.
           - "STD_WPU"
           - "STD_WPD"
           - "OD"
           - "ANALOG"
           - "WAKE_HIGH"
           - "WAKE_LOW"
           description: |
              the pin type
              ... {
                  type = "ANALOG"; 
              };
              we select analog for the ADC
              
```

## dts/bindings/pwm/ti,tiva-pwm.yaml
```yaml
# Copyright (c) 2021 Stefan Jaritz, TIER SE
# SPDX-License-Identifier: Apache-2.0

description: TI Tiva PWM periphal

compatible: "ti,tiva-pwm"

# include: [pwm-controller.yaml, base.yaml]

include: base.yaml

properties:
   reg:
      required: true
   
   label:
      required: true
      
   pinctrl-0:
      type: phandles
      required: false
      description: |
         GPIO pin configuration for PWM signal/s. We expect that the phandles
         will reference pinctrl nodes

   sysclk-div:
      type: int
      required: true
      description: sys clk dividerr
```

## dts/bindings/serial/ti,tiva-uart.yaml
```yaml
# Copyright (c) 2021 Stefan Jaritz, TIER SE
# SPDX-License-Identifier: Apache-2.0

description: TI TIVA UART

compatible: "ti,tiva-uart"

include: uart-controller.yaml

properties:
    reg:
      required: true

    interrupts:
      required: true
      
    pinctrl-0:
      type: phandles
      required: false
      description: |
        pin configuration for serial signals.  We expect
        that the phandles will reference pinctrl nodes.

        For example the uart0 would be
           pinctrl-0 = <&uart0_rx &uart0_tx>;
```

## dts/bindings/ti,drv8830drcr.yaml
```yaml
# Copyright (c) 2021 Kamil Sroka, TIER GmbH
# SPDX-License-Identifier: Apache-2.0

description: DRV8830DRCR H bridge

compatible: "ti,drv8830drcr"

include: i2c-device.yaml
```

## dts/bindings/ti,pcf8574.yaml
```yaml
# Copyright (c) 2021 Stefan Jaritz, TIER SE
# SPDX-License-Identifier: Apache-2.0

description: PCF8574 Remote 8-Bit I/O Expander

compatible: "ti,pcf8574"

include:
    - name: base.yaml

properties:
   label:
      required: true      
```

## dts/bindings/ti,tlc5973.yaml
```yaml
# Copyright (c) 2021 Stefan Jaritz, TIER SE
# SPDX-License-Identifier: Apache-2.0

description: TLC5973 3-Channel, 12-Bit, PWM Constant-Current LED Driver with Single-Wire Interface

compatible: "ti,tlc5973"

include:
    - name: base.yaml

properties:
   label:
      required: true
     
   sdi-gpios:
      type: phandle-array
      required: true
      description: |
         serial datat in pin    

   clkGen:
      type: phandle
      required: true    
      description: |
         reference to timer that generates the time slices 

   amount:
      type: int
      required: true
      description: |
         amount of TLC5973 at the cascade
      
```

## dts/bindings/ti,tmp1075.yaml
```yaml
# Copyright (c) 2021 Stefan Jaritz, TIER SE
# SPDX-License-Identifier: Apache-2.0

description: TMP1075 Temperature Sensor 

compatible: "ti,tmp1075"

include: i2c-device.yaml
```

## dts/bindings/tier,fan-3pin.yaml
```yaml
# Copyright (c) 2021 Stefan Jaritz, TIER SE
# SPDX-License-Identifier: Apache-2.0

description: |
    3 pin fan

compatible: "tier,fan-3pin"

include:
    - name: base.yaml

properties:
    label:
        required: true
        
    drv-gpios:
        type: phandle-array
        required: true
        
    timer:
       type: phandle
       required: false    
       description: |
          reference to the can periphal 

    subtimer:
      required: false
      type: string
      default: "A"
      enum:
      - "A" # Default value.
      - "B"
      description: |
        the TI timer has 2 timers A and B so we need to select one
        ... {
            subtimer = "B"; 
        };
        we select timer B
 
    pinctrl-0:
      type: phandles
      required: false
      description: |
        pin that is used for tacho monitoring
        pinctrl-0 = <&fan1_tach>;
 
```

## dts/bindings/tier,gpio-light-controller.yaml
```yaml
# Copyright (c) 2021 Kamil Sroka, TIER GmbH
# SPDX-License-Identifier: Apache-2.0

description: |
   gpio light controller

compatible: "tier,gpio-light-controller"

include:
    - name: base.yaml

properties:
   label:
      required: true

   light-gpios:
      type: phandle-array
      required: true
      description: |
         light control pin
```

## dts/bindings/tier,mq2.yaml
```yaml
# Copyright (c) 2021 Stefan Jaritz, TIER SE
# SPDX-License-Identifier: Apache-2.0

description: |
    driver for the fish fly MQ2 board

compatible: "tier,mq2"

include:
    - name: base.yaml

properties:
    label:
        required: true
        
    alarm-gpios:
        type: phandle-array
        required: true    

    adc:
       type: phandle
       required: true    
       description: |
          reference to timer that generates the time slices 

    adc_seqNum:
       type: int
       required: true    
       description: |
          sequencer number that is used for the adc conversion 

    adc_channel:
       type: int
       required: true    
       description: |
          adc channel number that is used for the adc conversion 
```

## dts/bindings/tier,muxed-can.yaml
```yaml
# Copyright (c) 2021 Stefan Jaritz, TIER SE
# SPDX-License-Identifier: Apache-2.0

description: |
    muxed can 

compatible: "tier,muxed-can"

include:
    - name: base.yaml

properties:
    label:
       required: true

    can:
       type: phandle
       required: true    
       description: |
          reference to the can periphal 

    pinctrl-0:
       type: phandles
       required: false
       description: |
         GPIO pin configuration s* and oe. The phandles are
         expected to reference pinctrl nodes, e.g.
      
           pinctrl-0 = <&can0_s0c>;
        
    s0-gpios:
        type: phandle-array
        required: true    

    s1-gpios:
        type: phandle-array
        required: true    

    s2-gpios:
        type: phandle-array
        required: true    

    s3-gpios:
        type: phandle-array
        required: true    

    oe-gpios:
        type: phandle-array
        required: true    
        
```
