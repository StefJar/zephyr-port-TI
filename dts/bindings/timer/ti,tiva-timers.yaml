## dts/bindings/timer/ti,tiva-timers.yaml
```yaml
# Copyright (c) 2021 Stefan Jaritz, TIER SE
# SPDX-License-Identifier: Apache-2.0

description: TI TIVA timers

compatible: "ti,tiva-timers"

include: base.yaml

properties:
   label:
      required: true
   
   reg:
      required: true
      
   prescaler:
      type: int
      required: true
      default: 0
      description: |
         timer prescaler. 0 means no prescalor

   interrupts:
      required: true
      description: |
         list with 4 interrupts. The first for the timer A 16/32Bit, 2nd for the timer A 32/64Bit interrupt, 3rd for the timer B 16/32Bit and 4th for the timer B 32/64Bit interrupt.

   pinctrl-0:
      type: phandles
      required: false
      description: |
        GPIO pin configuration for the differnt timer capture functions. The phandles are
        expected to reference pinctrl nodes, e.g.
      
          pinctrl-0 = <&timer0a_cc>;
 
```

## dts/bindings/watchdog/ti,tiva-wdt.yaml
```yaml
# Copyright (c) 2021 Stefan Jaritz, TIER SE
# SPDX-License-Identifier: Apache-2.0

description: TI TIVA watchdog

compatible: "ti,tiva-wdt"

include: base.yaml

properties:
   label:
      required: true
   
   reg:
      required: true
      
   interrupts:
      required: true
      description: |
         list with 1 interrupt. the watchdog can use that intr.
```

## soc/arm/ti_tm4c12xx/Kconfig
```kconfig
# TI LM3S6965 platform configuration options

# Copyright (c) 2014-2015 Wind River Systems, Inc.
# SPDX-License-Identifier: Apache-2.0

choice
    prompt "TI TM4C12XX MCU Selection"
	depends on SOC_SERIES_TI_TM4C12XX

config SOC_TI_TM4C123GH6PGE
	bool "TM4C123GH6PGE"
	select SOC_TI_TM4C12XX
	help
	  Enable support for TI TM4C12XX MCU series

config SOC_TI_TM4C1230H6PM
	bool "TM4C1230H6PM"
	select SOC_TI_TM4C12XX
	help
	  Enable support for TI TM4C12XX MCU series

endchoice

config SOC_TI_TM4C12XX
	bool
```

## soc/arm/ti_tm4c12xx/Kconfig.defconfig
```kconfig
# TI LM3S6965 platform configuration options

# Copyright (c) 2014-2015 Wind River Systems, Inc.
# SPDX-License-Identifier: Apache-2.0

if SOC_TI_TM4C123GH6PGE

config SOC
	default "ti_tm4c123gh6pge"

endif

if SOC_TI_TM4C1230H6PM

config SOC
	default "ti_tm4c1230h6pm"

endif

if SOC_TI_TM4C12XX

config SOC_SERIES
	default "ti_tm4c12xx"

config NUM_IRQS
	default 154

config SYS_CLOCK_HW_CYCLES_PER_SEC
	default 80000000

config FPU
	default n

config MPU
	default n

config HW_STACK_PROTECTION
 	default n

config SW_VECTOR_RELAY
	default y

config CORTEX_M_DWT
	default y

config SERIAL
	default y

config UART_INTERRUPT_DRIVEN
	default y

endif
```

## soc/arm/ti_tm4c12xx/Kconfig.soc
```kconfig
# SPDX-License-Identifier: Apache-2.0

config SOC_SERIES_TI_TM4C12XX
	bool "TI TM4C12XX Series MCU"

	select ARM
	select CPU_CORTEX_M4
	select CPU_CORTEX_M_HAS_DWT
	select HAS_SWO
	select HAS_SEGGER_RTT
	select BUILD_OUTPUT_HEX

	select SERIAL_HAS_DRIVER
	select SERIAL_SUPPORT_INTERRUPT
	help
	  Enable support for TI TM4C12XX MCU series
```
