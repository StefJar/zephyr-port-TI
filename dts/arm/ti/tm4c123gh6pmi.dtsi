/*
 * Copyright (c) 2021 TIER SE
 *
 * SPDX-License-Identifier: Apache-2.0
 */


#include <mem.h>
#include <ti/tm4c12xx.dtsi>

/ {
	sram0: memory@20000000 {
		reg = <0x20000000 DT_SIZE_K(32)>;
	};	
};